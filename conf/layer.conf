## conf/layer.conf
```bitbake
# Copyright (c) 2021, ADLINK Technology Inc
#
# SPDX-License-Identifier: MIT

# We have a conf and classes directory, add to BBPATH
BBPATH .= ":${LAYERDIR}"

# We have recipes-* directories, add to BBFILES
BBFILES += "${LAYERDIR}/recipes-*/*/*.bb \
            ${LAYERDIR}/recipes-*/*/*.bbappend"

BBFILE_COLLECTIONS += "meta-adlink-ampere"
BBFILE_PATTERN_meta-adlink-ampere= "^${LAYERDIR}/"
BBFILE_PRIORITY_meta-adlink-ampere = "5"

LAYERSERIES_COMPAT_meta-adlink-ampere = " honister kirkstone"
```

## conf/machine/ava.conf
```bitbake
# Copyright (c) 2021, ADLINK Technology Inc
#
# SPDX-License-Identifier: MIT

require conf/machine/include/ampere.inc

MACHINE_FEATURES += "acpi efi pcbios pci rtc serial usbhost vfat"

SERIAL_CONSOLES = "115200;ttyAMA0"

# Prevent wic plugin from adding extra entries to fstab.
# By default wic plugin will append an entry to mount /dev/sda1 partition
# under /boot path, which is incorrect if wic image is flashed to /dev/nvme0n1,
# causing an error during system boot.
WIC_CREATE_EXTRA_ARGS:append = " --no-fstab-update"

IMAGE_CLASSES:append = " image-tweaks-ava-machine"
```

## conf/machine/comhpc.conf
```bitbake
# Copyright (c) 2021, ADLINK Technology Inc
#
# SPDX-License-Identifier: MIT

require conf/machine/include/ampere.inc

MACHINE_FEATURES += "acpi efi pcbios pci rtc serial usbhost vfat"

SERIAL_CONSOLES = "115200;ttyAMA0"
```

## conf/machine/include/ampere.inc
```bitbake
# Copyright (c) 2021, ADLINK Technology Inc
#
# SPDX-License-Identifier: MIT

require conf/machine/include/arm/armv8-2a/tune-neoversen1.inc

# Use kernel provided by ampere
PREFERRED_PROVIDER_virtual/kernel ?= "linux-ampere-lts"
PREFERRED_VERSION_linux-ampere-lts ?= "5.15%"
KERNEL_IMAGETYPE = "Image"

IMAGE_FSTYPES += "tar.bz2 wic.gz wic.bmap"

EFI_PROVIDER ?= "grub-efi"

GRUB_CFG_FILE ?= "ampere-grub.cfg"
WKS_FILE ?= "ampere-efidisk.wks.in"
```

## dynamic-layers/meta-virtualization/conf/machine/include/image-tweaks-comhpc-machine-xen.inc
```bitbake
# SPDX-License-Identifier: MIT

GRUB_CFG_FILE ?= "${ADLINK_AMPERE_VIRTUALIZATION_DYNAMIC_DIR}/wic/ampere-xen-grub.cfg"

WKS_SEARCH_PATH:prepend = "${ADLINK_AMPERE_VIRTUALIZATION_DYNAMIC_DIR}/wic:"

IMAGE_EFI_BOOT_FILES += "xen-comhpc.efi;xen.efi xen.cfg \
                     ${ADLINK_AMPERE_LAYERDIR}/wic/ampere-grub.cfg;./EFI/BOOT"

do_image_wic[depends] += "xen:do_deploy"
```

## wic/adlink-efidisk.wks
```
# short-description: Create an EFI disk image
# long-description: Creates a partitioned EFI disk image that the user
# can directly dd to boot media. Uses a custom grub.cfg file to configure the boot.

part /boot --source bootimg-efi --sourceparams=""loader=grub-efi"" --label msdos --active --align 1024 --size 256

part / --source rootfs --fstype=ext4 --label root --align 1024 --size 4096 --use-uuid

part /  --fstype=ext4 --label data --align 1024 --size 1024 

bootloader --ptable gpt --configfile="adlink-grub.cfg" --timeout=5
```

## wic/ampere-efidisk.wks
```
# short-description: Create an EFI disk image
# long-description: Creates a partitioned EFI disk image that the user
# can directly dd to boot media. Uses a custom grub.cfg file to configure the boot.

part /boot --source bootimg-efi --sourceparams=""loader=grub-efi"" --label msdos --active --align 1024 --size 256

part / --source rootfs --fstype=ext4 --label root --align 1024 --size 4096 --uuid=4b66a769-a366-411b-85f3-c95deec572b4

bootloader --ptable gpt --configfile="ampere-grub.cfg" --timeout=5
```
